## Kconfig
```kconfig
config KEYBALL61_NUMLOCK_SCREEN
    bool "Show Num Lock state on the Keyball61 central OLED"
    default n
    depends on ZMK_DISPLAY
    depends on ZMK_SPLIT_ROLE_CENTRAL
```

## config/west.yml
```yaml
manifest:
  remotes:
    - name: zmkfirmware
      url-base: https://github.com/zmkfirmware
    - name: mochukeeb
      url-base: https://github.com/mochukeeb
    - name: urob
      url-base: https://github.com/urob
  projects:
    - name: zmk
      remote: zmkfirmware
      # Pin the exact source revision used for the verified firmware build.
      revision: edf5c0814fd3ea202e43aad2d68fd32e882a518c
      import: app/west.yml
    - name: zmk-unicode
      remote: urob
      revision: 3e8ca744e5c3b6f430b3713f3e45b806ce89be7b
    - name: zmk-pmw3610-driver
      remote: mochukeeb
      revision: 77a61804cf0d51a495a22e60d1a3115568a441df
  self:
    path: config
```
